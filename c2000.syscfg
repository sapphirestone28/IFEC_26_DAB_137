/**
 * These arguments were used when this file was generated. They will be automatically applied on subsequent loads
 * via the GUI or CLI. Run CLI with '--help' for additional information on how to override these arguments.
 * @cliArgs --device "F280013x" --part "F280013x_64PM" --package "64PM" --context "system" --product "C2000WARE@6.00.01.00"
 * @v2CliArgs --device "TMS320F2800137" --package "64PM" --context "system" --product "C2000WARE@6.00.01.00"
 * @versions {"tool":"1.26.2+4477"}
 */

/**
 * Import the modules used in this configuration.
 */
const adc     = scripting.addModule("/driverlib/adc.js", {}, false);
const adc1    = adc.addInstance();
const adc2    = adc.addInstance();
const analog  = scripting.addModule("/driverlib/analog.js", {}, false);
const analog1 = analog.addInstance();
const epwm    = scripting.addModule("/driverlib/epwm.js", {}, false);
const epwm1   = epwm.addInstance();
const epwm2   = epwm.addInstance();
const epwm3   = epwm.addInstance();
const epwm4   = epwm.addInstance();
const gpio    = scripting.addModule("/driverlib/gpio.js", {}, false);
const gpio1   = gpio.addInstance();
const gpio2   = gpio.addInstance();
const gpio3   = gpio.addInstance();
const gpio4   = gpio.addInstance();
const sysctl  = scripting.addModule("/driverlib/sysctl.js");

/**
 * Write custom configuration values to the imported modules.
 */
adc1.$name                    = "myADC1";
adc1.adcClockPrescaler        = "ADC_CLK_DIV_4_0";
adc1.enabledSOCs              = ["ADC_SOC_NUMBER0","ADC_SOC_NUMBER1"];
adc1.soc0Trigger              = "ADC_TRIGGER_EPWM1_SOCA";
adc1.soc0SampleWindow         = 15;
adc1.soc1Channel              = "ADC_CH_ADCIN1";
adc1.soc1Trigger              = "ADC_TRIGGER_EPWM1_SOCA";
adc1.soc1SampleWindow         = 15;
adc1.interruptPulseMode       = "ADC_PULSE_END_OF_CONV";
adc1.enabledInts              = ["ADC_INT_NUMBER1"];
adc1.interrupt1SOCSource      = "ADC_SOC_NUMBER1";
adc1.enableInterrupt1         = true;
adc1.registerInterrupts       = ["1"];
adc1.adcInt1.$name            = "myADC11_IN";
adc1.adcInt1.interruptHandler = "DAB_Fast_ISR";
adc1.adcInt1.enableInterrupt  = true;

adc2.$name               = "myADC2";
adc2.adcClockPrescaler   = "ADC_CLK_DIV_4_0";
adc2.enabledSOCs         = ["ADC_SOC_NUMBER0","ADC_SOC_NUMBER1"];
adc2.soc0Trigger         = "ADC_TRIGGER_EPWM1_SOCA";
adc2.soc0SampleWindow    = 15;
adc2.soc1Trigger         = "ADC_TRIGGER_EPWM1_SOCA";
adc2.soc1SampleWindow    = 15;
adc2.interruptPulseMode  = "ADC_PULSE_END_OF_CONV";
adc2.interrupt1SOCSource = "ADC_SOC_NUMBER1";
adc2.enableInterrupt1    = true;
adc2.registerInterrupts  = ["1"];
adc2.adcBase             = "ADCC_BASE";
adc2.enabledPPBs         = ["ADC_PPB_NUMBER1","ADC_PPB_NUMBER2"];
adc2.ppb1ReferenceOffset = 2048;
adc2.ppb2SOCNumber       = "ADC_SOC_NUMBER1";
adc2.ppb2ReferenceOffset = 2048;
adc2.useInterrupts       = false;
adc2.soc0Channel         = "ADC_CH_ADCIN9";
adc2.soc1Channel         = "ADC_CH_ADCIN5";

analog1.$name                                 = "myANALOGPinMux0";
adc1.analog                                   = analog1;
adc2.analog                                   = analog1;
analog1.analog.$assign                        = "ANALOG";
analog1.analog["a0/c15/cmp1_daclPin"].$assign = "A0/C15/CMP1_DACL";
analog1.analog.a1Pin.$assign                  = "A1";

epwm1.epwmTimebase_hsClockDiv                                    = "EPWM_HSCLOCK_DIVIDER_1";
epwm1.epwmTimebase_counterMode                                   = "EPWM_COUNTER_MODE_UP_DOWN";
epwm1.epwmTimebase_period                                        = 240;
epwm1.epwmTimebase_syncOutPulseMode                              = ["EPWM_SYNC_OUT_PULSE_ON_CNTR_ZERO"];
epwm1.epwmCounterCompare_cmpA                                    = 120;
epwm1.epwmCounterCompare_shadowLoadModeCMPA                      = "EPWM_COMP_LOAD_ON_SYNC_ONLY";
epwm1.epwmActionQualifier_EPWM_AQ_OUTPUT_A_ON_TIMEBASE_UP_CMPA   = "EPWM_AQ_OUTPUT_LOW";
epwm1.epwmActionQualifier_EPWM_AQ_OUTPUT_A_ON_TIMEBASE_DOWN_CMPA = "EPWM_AQ_OUTPUT_HIGH";
epwm1.epwmDeadband_delayRED                                      = 4;
epwm1.epwmDeadband_delayFED                                      = 4;
epwm1.epwmDeadband_enableRED                                     = true;
epwm1.epwmDeadband_enableFED                                     = true;
epwm1.epwmEventTrigger_EPWM_SOC_A_triggerEnable                  = true;
epwm1.epwmEventTrigger_EPWM_SOC_A_triggerSource                  = "EPWM_SOC_TBCTR_ZERO";
epwm1.epwmEventTrigger_EPWM_SOC_A_triggerEventPrescalar          = "5";
epwm1.epwmDeadband_polarityFED                                   = "EPWM_DB_POLARITY_ACTIVE_LOW";
epwm1.$name                                                      = "myEPWM1";
epwm1.epwm.$assign                                               = "EPWM1";

epwm2.epwmTimebase_hsClockDiv                                    = "EPWM_HSCLOCK_DIVIDER_1";
epwm2.epwmTimebase_period                                        = 240;
epwm2.epwmTimebase_counterMode                                   = "EPWM_COUNTER_MODE_UP_DOWN";
epwm2.epwmTimebase_phaseEnable                                   = true;
epwm2.epwmTimebase_counterModeAfterSync                          = "EPWM_COUNT_MODE_UP_AFTER_SYNC";
epwm2.epwmTimebase_phaseShift                                    = 2;
epwm2.epwmCounterCompare_cmpA                                    = 120;
epwm2.epwmActionQualifier_EPWM_AQ_OUTPUT_A_ON_TIMEBASE_UP_CMPA   = "EPWM_AQ_OUTPUT_LOW";
epwm2.epwmActionQualifier_EPWM_AQ_OUTPUT_A_ON_TIMEBASE_DOWN_CMPA = "EPWM_AQ_OUTPUT_HIGH";
epwm2.epwmDeadband_enableRED                                     = true;
epwm2.epwmDeadband_enableFED                                     = true;
epwm2.epwmDeadband_polarityFED                                   = "EPWM_DB_POLARITY_ACTIVE_LOW";
epwm2.epwmDeadband_delayRED                                      = 4;
epwm2.epwmDeadband_delayFED                                      = 4;
epwm2.$name                                                      = "myEPWM2";
epwm2.epwm.$assign                                               = "EPWM2";

epwm3.epwmTimebase_hsClockDiv                                    = "EPWM_HSCLOCK_DIVIDER_1";
epwm3.epwmTimebase_period                                        = 240;
epwm3.epwmTimebase_counterMode                                   = "EPWM_COUNTER_MODE_UP_DOWN";
epwm3.epwmTimebase_phaseEnable                                   = true;
epwm3.epwmTimebase_counterModeAfterSync                          = "EPWM_COUNT_MODE_UP_AFTER_SYNC";
epwm3.epwmTimebase_phaseShift                                    = 2;
epwm3.epwmCounterCompare_cmpA                                    = 120;
epwm3.epwmActionQualifier_EPWM_AQ_OUTPUT_A_ON_TIMEBASE_UP_CMPA   = "EPWM_AQ_OUTPUT_LOW";
epwm3.epwmActionQualifier_EPWM_AQ_OUTPUT_A_ON_TIMEBASE_DOWN_CMPA = "EPWM_AQ_OUTPUT_HIGH";
epwm3.epwmDeadband_enableRED                                     = true;
epwm3.epwmDeadband_enableFED                                     = true;
epwm3.epwmDeadband_polarityFED                                   = "EPWM_DB_POLARITY_ACTIVE_LOW";
epwm3.epwmDeadband_delayRED                                      = 4;
epwm3.epwmDeadband_delayFED                                      = 4;
epwm3.$name                                                      = "myEPWM3";
epwm3.epwm.$assign                                               = "EPWM3";

epwm4.epwmTimebase_hsClockDiv                                    = "EPWM_HSCLOCK_DIVIDER_1";
epwm4.epwmTimebase_period                                        = 240;
epwm4.epwmTimebase_counterMode                                   = "EPWM_COUNTER_MODE_UP_DOWN";
epwm4.epwmTimebase_phaseEnable                                   = true;
epwm4.epwmTimebase_counterModeAfterSync                          = "EPWM_COUNT_MODE_UP_AFTER_SYNC";
epwm4.epwmTimebase_phaseShift                                    = 2;
epwm4.epwmCounterCompare_cmpA                                    = 120;
epwm4.epwmActionQualifier_EPWM_AQ_OUTPUT_A_ON_TIMEBASE_UP_CMPA   = "EPWM_AQ_OUTPUT_LOW";
epwm4.epwmActionQualifier_EPWM_AQ_OUTPUT_A_ON_TIMEBASE_DOWN_CMPA = "EPWM_AQ_OUTPUT_HIGH";
epwm4.epwmDeadband_enableRED                                     = true;
epwm4.epwmDeadband_enableFED                                     = true;
epwm4.epwmDeadband_polarityFED                                   = "EPWM_DB_POLARITY_ACTIVE_LOW";
epwm4.epwmDeadband_delayRED                                      = 4;
epwm4.epwmDeadband_delayFED                                      = 4;
epwm4.$name                                                      = "myEPWM4";

gpio1.$name             = "LED_DEBUG";
gpio1.direction         = "GPIO_DIR_MODE_OUT";
gpio1.writeInitialValue = true;

gpio2.$name             = "PWM_ENABLE";
gpio2.direction         = "GPIO_DIR_MODE_OUT";
gpio2.writeInitialValue = true;

gpio3.$name             = "RELAY_PRECHARGE";
gpio3.direction         = "GPIO_DIR_MODE_OUT";
gpio3.writeInitialValue = true;

gpio4.$name             = "RELAY_MAIN";
gpio4.direction         = "GPIO_DIR_MODE_OUT";
gpio4.writeInitialValue = true;

/**
 * Pinmux solution for unlocked pins/peripherals. This ensures that minor changes to the automatic solver in a future
 * version of the tool will not impact the pinmux you originally saw.  These lines can be completely deleted in order to
 * re-solve from scratch.
 */
analog1.analog["a10/c10, gpio230Pin"].$suggestSolution = "A10/C10, GPIO230";
analog1.analog["a11/c0Pin"].$suggestSolution           = "A11/C0";
analog1.analog["a12/c1Pin"].$suggestSolution           = "A12/C1";
analog1.analog["a15/c7Pin"].$suggestSolution           = "A15/C7";
analog1.analog["a16/c16, gpio28Pin"].$suggestSolution  = "A16/C16, GPIO28";
analog1.analog["a17/c17, gpio20Pin"].$suggestSolution  = "A17/C17, GPIO20";
analog1.analog["a18/c18, gpio21Pin"].$suggestSolution  = "A18/C18, GPIO21";
analog1.analog["a19/c19, gpio13Pin"].$suggestSolution  = "A19/C19, GPIO13";
analog1.analog["a2/c9, gpio224Pin"].$suggestSolution   = "A2/C9, GPIO224";
analog1.analog["a20/c20, gpio12Pin"].$suggestSolution  = "A20/C20, GPIO12";
analog1.analog["a3/c5, gpio242Pin"].$suggestSolution   = "A3/C5, GPIO242";
analog1.analog["a4/c14Pin"].$suggestSolution           = "A4/C14";
analog1.analog["a5/c2Pin"].$suggestSolution            = "A5/C2";
analog1.analog["a6, gpio228Pin"].$suggestSolution      = "A6, GPIO228";
analog1.analog["a7/c3Pin"].$suggestSolution            = "A7/C3";
analog1.analog["a8/c11Pin"].$suggestSolution           = "A8/C11";
analog1.analog["c4/a14Pin"].$suggestSolution           = "C4/A14";
analog1.analog["c6, gpio226Pin"].$suggestSolution      = "C6, GPIO226";
analog1.analog["c8/a9, gpio227Pin"].$suggestSolution   = "C8/A9, GPIO227";
epwm1.epwm.epwm_aPin.$suggestSolution                  = "GPIO4";
epwm1.epwm.epwm_bPin.$suggestSolution                  = "GPIO5";
epwm2.epwm.epwm_aPin.$suggestSolution                  = "GPIO41";
epwm2.epwm.epwm_bPin.$suggestSolution                  = "GPIO3";
epwm3.epwm.epwm_aPin.$suggestSolution                  = "GPIO0";
epwm3.epwm.epwm_bPin.$suggestSolution                  = "GPIO1";
epwm4.epwm.$suggestSolution                            = "EPWM4";
epwm4.epwm.epwm_aPin.$suggestSolution                  = "GPIO2";
epwm4.epwm.epwm_bPin.$suggestSolution                  = "GPIO23";
gpio1.gpioPin.$suggestSolution                         = "GPIO29";
gpio2.gpioPin.$suggestSolution                         = "GPIO11";
gpio3.gpioPin.$suggestSolution                         = "GPIO33";
gpio4.gpioPin.$suggestSolution                         = "GPIO16";
